#include <reg52.h>
#include <intrins.h>
#include <stdio.h>
#include <rtx51tny.h> 
sfr P4=0xc0;    //定义P4口特殊功能寄存器 (以下简称sfr)
sfr P4M0=0xb4;  //因EN需要推挽状态输出1才能点亮屏,所以定义两个设置P4口状态的sfr
sfr P4M1=0xb3;
sfr P1M0=0x92;  // P1口上电有高阻状态的,需改回普通上拉状态,定义这俩sfr
sfr P1M1=0x91; 
sbit CS=P1^6;   //屏 片选引脚
sbit EN=P4^4;   //屏供电使能引脚,强高有效
sbit ZKCS=P1^7; //字库芯片 片选引脚
//字库和屏使用STC硬件SPI接口SCLK=P1.5  SDAT=P1.3  字库的返回值DOUT=P1.4


//------------------------------------以下为SPI配置程序------------------------------------------
//SPI 特殊功能寄存器
sfr SPSTAT=0xCD;   //SPI状态寄存器
sfr SPCTL =0xCE;   //SPI控制寄存器
sfr SPDAT =0xCF;   //SPI数据寄存器

#define	SSIG		1	//1: 忽略SS脚，由MSTR位决定主机还是从机		0: SS脚用于决定主从机。
#define	SPEN		1	//1: 允许SPI，								0：禁止SPI，所有SPI管脚均为普通IO
#define	DORD		1	//1：LSB先发，								0：MSB先发
#define	MSTR		1	//1：设为主机								0：设为从机
#define	CPOL		1	//1: 空闲时SCLK为高电平，					0：空闲时SCLK为低电平
#define	CPHA		1	//1: SCLK前沿驱动,后沿采样    0:SS==0时SCLK前沿采样,后沿驱动
#define	SPR1		0	//SPR1,SPR0   00: fosc/4,     01: fosc/16
#define	SPR0		0	//            10: fosc/64,    11: fosc/128
#define	SPEED_4		0	// fosc/4

void init_spi_disp()   //将硬件SPI初始化成屏所需要的状态(主机,数据LSB在前)
{
ZKCS=1;
SPCTL = (SSIG << 7) + (SPEN << 6) + (DORD << 5) + (MSTR << 4) + (CPOL << 3) + (CPHA << 2) + SPEED_4; // SSIG，SPEN，DORD，MSTR，CPOL，CPHA，SPR1，SPR0。 1110,1100
SPSTAT = 0xC0;   //清除spi中断标志
}
void init_spi_zk()     //将硬件SPI初始化成字库所需要的状态(主机,数据MSB在前)
{CS=1;
SPCTL = 0xdc;
SPSTAT = 0xC0;   //清除spi中断标志
ZKCS=0;
}

unsigned char writebyte(unsigned char dat)   //SPI发送并接收一个数据
{
     SPDAT = dat;      //发送数据
     while(!(SPSTAT & 0x80) );  //等待发送完毕 SPIF = 1
		 SPSTAT = 0xc0;     //清除SPI标志
		 return SPDAT;
} 	
//-------------------------------------------以上SPI配置程序----------------------------------------------------

//屏显示所用的4种ASCII字库,分别为16x8,12x8,12x6,8x6点阵字符,若是不都用可以删掉字库并在char_str()函数里面修改

/****************************************8*16的点阵************************************/
// !"#$%&'()*+,-./0123456789:;<=>?@ABCDEFGHIJKLMNOPQRSTUVWXYZ[\]^_`abcdefghijklmnopqrstuvwxyz{|}~
code unsigned char  ZM168[]=	  
{


0x00,0x00,0x00,0x00,0x00,0x00,0x00,0x00,0x00,0x00,0x00,0x00,0x00,0x00,0x00,0x00,/*" ",0*/
0x00,0x00,0x00,0x00,0x00,0x00,0xFC,0x33,0x00,0x00,0x00,0x00,0x00,0x00,0x00,0x00,/*"!",1*/
0x00,0x00,0x00,0x00,0x3C,0x00,0x00,0x00,0x00,0x00,0x3C,0x00,0x00,0x00,0x00,0x00,/*""",2*/
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0x00,0x06,0x00,0x01,0x00,0x01,0x00,0x03,0x00,0x06,0x00,0x04,0x00,0x04,0x00,0x03,/*"~",94*/

};

code unsigned char ZM128[]=
{
0x00,0x00,0x00,0x00,0x00,0x00,0x00,0x00,0x00,0x00,0x00,0x00,//  
0x00,0x00,0x00,0x00,0xc0,0x2f,0x00,0x02,0x00,0x00,0x00,0x00,//! 
0x00,0x80,0x00,0x04,0x20,0x00,0x08,0x40,0x00,0x02,0x00,0x00,//" 
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0x00,0x20,0x00,0x01,0x10,0x00,0x02,0x20,0x00,0x04,0x40,0x00,//~ 
};

code unsigned char ZM126[]={
0x00,0x00,0x00,0x00,0x00,0x00,0x00,0x00,0x00,//  
0x00,0x00,0x00,0x00,0xe0,0x67,0x00,0x00,0x00,//! 
0x00,0x80,0x00,0x06,0x80,0x00,0x06,0x00,0x00,//" 
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0x00,0x40,0x00,0x02,0x20,0x00,0x04,0x20,0x00,//~ 
};

code unsigned char ZM68[] =		
{
0x00, 0x00, 0x00, 0x00, 0x00, 0x00,// sp
0x00, 0x00, 0x00, 0x2f, 0x00, 0x00,// !
0x00, 0x00, 0x07, 0x00, 0x07, 0x00,// "
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0x02,0x01,0x01,0x02,0x02,0x01,//~3
};


	   


void init_vfd(void)
{
P1M0=0;
P1M1=0;
P4M1=0;
P4M0=0x10;  //设置P4.4 EN引脚为强推挽状态

init_spi_disp();
CS=0;writebyte(0xaa);CS=1; //vfd指令1,复位
os_wait2(2,2);//等效延时2ms,可自行替换为delay()函数
CS=0;writebyte(0x55);CS=1;  //vfd指令2,显存复位
os_wait2(2,10);//等效延时10ms,可自行替换为delay()函数
CS=0;writebyte(0xcc);writebyte(0x02);writebyte(0x00);CS=1;//vfd指令3 必要初始化
CS=0;writebyte(0xe0); writebyte(0xfc);writebyte(0x3e);writebyte(0x00);
writebyte(0x20);writebyte(0x80);writebyte(0x80);writebyte(0x80);CS=1; //vfd指令4 显示区域设置 行列值为253,63
CS=0;writebyte(0xb1);writebyte(0x20);writebyte(0x3f);writebyte(0x00);writebyte(0x01);CS=1;
CS=0;writebyte(0xd0);writebyte(0x00);writebyte(0xff);writebyte(0x40);CS=1;
CS=0;writebyte(0xa0);writebyte(0x0c);writebyte(0x40);CS=1;//最后一个是亮度值
CS=0;writebyte(0x80);writebyte(0x40);CS=1;	//开始显示
}

void light_set(unsigned char light)
{CS=0;
writebyte(0xa0);        //亮度调节
writebyte(0x0c);
writebyte(light);  		  //亮度
CS=1;
}
void char_str(unsigned char h,l,hl,unsigned char*zmk)
{
unsigned long Addr=0;  //字模所在字库芯片中的地址
pdata unsigned char zkj,GBCmsb,GBClsb,zhi_buff[32],zhi_buff12[18]; //字库用计数变量,GB2312编码高,低八位,读取字符缓冲区,12x12字符缓冲区
unsigned char sjs;  //显示用计数变量
if(hl==3)  //如果是16x8(支持汉字16x16字体)
	{while(*zmk!=0&l<32) //如果没遇到字符串结束标志(0),循环执行以下程序,反之退出
		{
		if(*zmk<0xa1) //如果不是GB2312字符
			{CS=0; 
			writebyte(0xf0);  //向屏上写显示数据命令
			writebyte(l*8);  //起始列(y)坐标  坐标值乘8方便使用
			writebyte(h*4);  //起始行(x)坐标  坐标值乘4方便使用
			writebyte(15);	 //屏每接收16位数据列坐标加1	 开始刷屏
					for(sjs=0;sjs<16;sjs++)
			writebyte(ZM168[sjs+((*zmk)-0x20)*16]);	 //取出数组中的ASCII字符的16个字模,刷到屏上  显示为一个16x8的字符
			zmk++;l++;  //字符串指针加1,显示列坐标加1
			CS=1;	
			}
		else
			{
		   GBCmsb=*zmk;  
		   zmk++;
 		   GBClsb=*zmk;
		   zmk++;    //以上取出一个双字节的GB2312字符
			if(GBCmsb==0xA9&GBClsb>0xA0) 
				Addr=(282+(GBClsb-0xA1))*(unsigned long)32; 
			else if(GBCmsb>0xA0&GBCmsb<0xA4)
					Addr=((GBCmsb-0xA1)*94+(GBClsb-0xA1))*(unsigned long)32; 
			else if(GBCmsb>0xAF&GBCmsb<0xF8)
				Addr=((GBCmsb-0xB0)*94+(GBClsb-0xA1)+846)*(unsigned long)32;  //以上计算此字符在字库芯片中的地址
			init_spi_zk();  //将硬件spi初始化成字库需要的MSB先发的形式
			writebyte(0x03); //读取命令
			writebyte((unsigned char)(Addr/65536));
			writebyte((unsigned char)(Addr%65536/256));
			writebyte((unsigned char)(Addr%256));  //将3字符的地址写到字库芯片
			for(zkj=0;zkj<32;zkj++)  //连续读32个字符出来
				zhi_buff[zkj]=writebyte(0);
			ZKCS=1;
			init_spi_disp();//将硬件spi还原回成屏需要的LSB先发的形式
			CS=0;           //因字库芯片读出的是列行式字模编码,而屏需要逐列式编码,故分两次将列行编码刷到屏上
			writebyte(0xf0);
			writebyte(l*8);
			writebyte(h*4);
			writebyte(7);
			for(zkj=0;zkj<16;zkj++)
				writebyte(zhi_buff[zkj]);	
			CS=1;
			_nop_();_nop_();_nop_();_nop_(); //防止单片机速度太快屏跟不上,等一会
			CS=0;
			writebyte(0xf0);
			writebyte(l*8);
			writebyte(h*4+8);
			writebyte(7);
			for(zkj=16;zkj<32;zkj++)
				writebyte(zhi_buff[zkj]);	
			CS=1;
			l+=2;   //完成刷一个16x16的GB2312字符,列坐标+2
			}
		}
	}
else if(hl==2)
	{
	while(*zmk!=0&l<32)
		{
		CS=0;
		writebyte(0xf0);
		writebyte(l*8);
		writebyte(h*4);
		writebyte(11);								//开始
				for(sjs=0;sjs<12;sjs++)
		writebyte(ZM128[sjs+((*zmk)-0x20)*12]);	
		zmk++;l++;
		CS=1;
		}
	}
else if(hl==1)
	{
	while(*zmk!=0&l<42)
		{
		if(*zmk<0xa1)
			{
			CS=0;
			writebyte(0xf0);
			writebyte(l*6);
			writebyte(h*4);
			writebyte(11);								//开始
					for(sjs=0;sjs<9;sjs++)
			writebyte(ZM126[sjs+((*zmk)-0x20)*9]);	
			zmk++;l++;
			CS=1;	
			}
		else
			{
		   GBCmsb=*zmk;
		   zmk++;
 		   GBClsb=*zmk;
		   zmk++;
			if(GBCmsb==0xA9&GBClsb>0xA0) 
				Addr=(282+(GBClsb-0xA1))*(unsigned long)24; 
			else if(GBCmsb>0xA0&GBCmsb<0xA4)
					Addr=((GBCmsb-0xA1)*94+(GBClsb-0xA1))*(unsigned long)24; 
			else if(GBCmsb>0xAF&GBCmsb<0xF8)
				Addr=((GBCmsb-0xB0)*94+(GBClsb-0xA1)+376)*(unsigned long)24;
			Addr+=0x3cf80;
			init_spi_zk();
			writebyte(0x03);
			writebyte((unsigned char)(Addr/65536));
			writebyte((unsigned char)(Addr%65536/256));
			writebyte((unsigned char)(Addr%256));
			for(zkj=0;zkj<24;zkj++)
				zhi_buff[zkj]=writebyte(0);
			for(zkj=0;zkj<6;zkj++)  //将16x12列行式字模转换成12x12逐列式字模
				{
				zhi_buff12[zkj*3]=zhi_buff[zkj*2];
				zhi_buff12[zkj*3+1]=zhi_buff[zkj*2+12]%16+(zhi_buff[zkj*2+1]%16)*16;
				zhi_buff12[zkj*3+2]=zhi_buff[zkj*2+1]/16+(zhi_buff[zkj*2+13]%16)*16;
				}
			//-----------------------
			ZKCS=1;
			init_spi_disp();
			CS=0;
			writebyte(0xf0);
			writebyte(l*6);
			writebyte(h*4);
			writebyte(11);
			for(zkj=0;zkj<18;zkj++)
				writebyte(zhi_buff12[zkj]);	
			CS=1;
			l+=2;
			}
		}
	}
else if(hl==0)
	{
	while(*zmk!=0&l<42)
		{
		CS=0;
		writebyte(0xf0);
		writebyte(l*6);
		writebyte(h*4);
		writebyte(7);								//开始
				for(sjs=0;sjs<6;sjs++)
		writebyte(ZM68[sjs+((*zmk)-0x20)*6]);	
		zmk++;l++;
		CS=1;	
		}
	}
}


sfr AUXR  = 0x8e;               //辅助寄存器
sfr P_SW1   = 0xA2;             //外设功能切换寄存器1
sfr T2H         =   0xD6;   //0000,0000 T2高字节
sfr T2L         =   0xD7;   //0000,0000 T2低字节

#define S1_S0 0x40              //P_SW1.6
#define S1_S1 0x80              //P_SW1.7


pdata unsigned char rec_buff[100];

bit busy;



 void uartinit(void)		//9600bps@24.000MHz
{
	SCON = 0x50;		//8位数据,可变波特率
	AUXR |= 0x04;		//定时器2时钟为Fosc,即1T
	T2L = 0x8F;		//设定定时初值
	T2H = 0xFD;		//设定定时初值
	AUXR |= 0x01;		//串口1选择定时器2为波特率发生器
	AUXR |= 0x10;		//启动定时器2
    ES = 1;                     //使能串口中断
	PS=1;
}

/*----------------------------
UART 中断服务程序
-----------------------------*/
void Uart() interrupt 4 
{
    if (RI)
    {
        RI = 0;                 //清除RI位
   
    }
    if (TI)
    {
        TI = 0;                 //清除TI位
        busy = 0;               //清忙标志
    }
}

/*----------------------------
发送串口数据
----------------------------*/
void SendData(unsigned char dat)
{
    while (busy);               //等待前面的数据发送完成
    busy = 1;
    SBUF =dat;
}

/*----------------------------
发送字符串
----------------------------*/
void SendStr(char *s)
{
    while (*s)                  //检测字符串结束标志
    {
        SendData(*s++);         //发送当前字符
    }
}

/*

void jx()
{idata unsigned char buf[16],out[12],i=0,j;
uartinit();
while(i<0x60)
{for(j=0;j<12;j++)
	buf[j]=ZM12[i*12+j];
out[0]=buf[0];	out[3]=buf[4];	out[6]=buf[8];
out[1]=buf[1]%16+(buf[2]%16)*16;out[4]=buf[5]%16+(buf[6]%16)*16;out[7]=buf[9]%16+(buf[10]%16)*16;
out[2]=buf[2]/16+(buf[3]%16)*16;out[5]=buf[6]/16+(buf[7]%16)*16;out[8]=buf[10]/16+(buf[11]%16)*16;

sprintf(rec_buff,"0x%02x,0x%02x,0x%02x,0x%02x,",(unsigned int)out[0],(unsigned int)out[1],(unsigned int)out[2],(unsigned int)out[3]);
SendStr(rec_buff);
sprintf(rec_buff,"0x%02x,0x%02x,0x%02x,0x%02x,",(unsigned int)out[4],(unsigned int)out[5],(unsigned int)out[6],(unsigned int)out[7]);
SendStr(rec_buff);
sprintf(rec_buff,"0x%02x,//%c \r\n",(unsigned int)out[8],i+0x20);
SendStr(rec_buff);
	i++;
}
}
*/
